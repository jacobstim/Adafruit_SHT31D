/***************************************************
  This is a library for the SHT31 Digital Humidity & Temp Sensor

  Designed specifically to work with the SHT31 Digital sensor from Adafruit
  ----> https://www.adafruit.com/products/2857

  These sensors use I2C to communicate, 2 pins are required to interface
  Adafruit invests time and resources providing this open source code,
  please support Adafruit and open-source hardware by purchasing
  products from Adafruit!

  Written by Limor Fried/Ladyada for Adafruit Industries.
  BSD license, all text above must be included in any redistribution

 ****************************************************

  Interrupt/Alert additions by Tim Jacobs for CegekaLabs (2017)
  Periodic Measurement additions by Tim Jacobs for CegekaLabs (2017)

  A word on periodic measurements: by default, the SHT31D performs
  single shot measurements, which you can call once every second, 2 times
  every second, once every minute, whatever. If you know you are
  doing periodic measurements, you can instruct the sensor to perform
  that measurement automatically with a specific frequency. This increases
  power consumption because the sensor is now always on & measuring, but
  also brings the advantage of allowing alerts to be triggered by the
  sensor -- you can now put the power hungry MCU to sleep and let the SHT31D
  do all the periodic checking of temperatures!

  I'm specifically using this sensor in a project where I measure every
  minute the temperature values, but I need to detect thresholds being exceeded.
  In that context, I enable Periodic Measurements with a 0.5Hz frequency. Sure,
  it might take 2 seconds before a temperature threshold alert is triggered, but
  we're using the sensor in situations where temperatures don't vary that fast
  anyway :).

 ****************************************************/


#include "Adafruit_SHT31.h"

/**************************************************************************
 **************************************************************************
 **************************************************************************
 * Constructor & initialization
 **************************************************************************
 **************************************************************************
 **************************************************************************/

Adafruit_SHT31::Adafruit_SHT31() {
  // By default & for backward compatibility we do single shot measurements
  _periodic = false;
}


boolean Adafruit_SHT31::begin(uint8_t i2caddr) {
  Wire.begin();
  _i2caddr = i2caddr;
  reset();
  //return (readStatus() == 0x40);
  return true;
}

/**************************************************************************
 **************************************************************************
 **************************************************************************
 * Sensor status reporting
 **************************************************************************
 **************************************************************************
 **************************************************************************/

 /**************************************************************************/
 /*!
     @brief   Checks whether an alert is pending on the sensor. An alert
              can be generated by a temperature/humidity threshold exceeded,
              or by a reset of the sensor.
     @return  Returns TRUE if an alert is pending.
 */
 /**************************************************************************/

boolean Adafruit_SHT31::isAlertPending() {
  _status.rawStatus = readStatus();
  return (_status.AlertPending > 0);
}

/**************************************************************************/
/*!
    @brief   Checks whether a temperature threshold alert is currently active.
    @return  Returns TRUE if a temperature alert is active.
*/
/**************************************************************************/

boolean Adafruit_SHT31::isAlertTemperature() {
  _status.rawStatus = readStatus();
  return (_status.T_TrackingAlert > 0);
}

/**************************************************************************/
/*!
    @brief   Checks whether a rel. humidity threshold alert is currently active.
    @return  Returns TRUE if a rel. humidity alert is active.
*/
/**************************************************************************/

boolean Adafruit_SHT31::isAlertHumidity() {
  _status.rawStatus = readStatus();
  return (_status.RH_TrackingAlert > 0);
}

/**************************************************************************/
/*!
    @brief   Checks whether an alert due to system reset is currently active.
    @return  Returns TRUE if a system reset was detected since last
             clearStatus() call.
*/
/**************************************************************************/

boolean Adafruit_SHT31::isAlertReset() {
  _status.rawStatus = readStatus();
  return (_status.SystemReset > 0);

}

/**************************************************************************/
/*!
    @brief   Retrieve current heater status
    @return  Returns TRUE if the heater is on, FALSE if the heater is off
*/
/**************************************************************************/

boolean Adafruit_SHT31::isHeaterOn() {
  _status.rawStatus = readStatus();
  return (_status.HeaterStatus > 0);
}


/**************************************************************************
 **************************************************************************
 **************************************************************************
 * Sensor control
 **************************************************************************
 **************************************************************************
 **************************************************************************/

 /**************************************************************************/
 /*!
     @brief   Reads the status register
     @return  Returns the raw 16-bit value of the status register.
 */
 /**************************************************************************/

uint16_t Adafruit_SHT31::readStatus(void) {
  writeCommand(SHT31_READSTATUS);
  Wire.requestFrom(_i2caddr, (uint8_t)3);
  uint16_t stat = Wire.read();
  stat <<= 8;
  stat |= Wire.read();
  //Serial.println(stat, HEX);

  // uint8_t raw_data[2];
  // raw_data[0] = Wire.read();
  // raw_data[1] = Wire.read();
  // uint16_t stat = (raw_data[0] << 8) | raw_data[1];
  return stat;
}


/**************************************************************************/
/*!
    @brief  Clears the status register. Use this to clear active interrupts,
            or indications for reset, etc..
*/
/**************************************************************************/

void Adafruit_SHT31::clearStatus() {
  writeCommand(SHT31_CLEARSTATUS);
}


/**************************************************************************/
/*!
    @brief  Perform a soft reset of the SHT sensor
*/
/**************************************************************************/

void Adafruit_SHT31::reset(void) {
  writeCommand(SHT31_SOFTRESET);
  delay(10);
}

/**************************************************************************/
/*!
    @brief  Turn heater on/off on the sensor
*/
/**************************************************************************/

void Adafruit_SHT31::heater(boolean h) {
  if (h)
    writeCommand(SHT31_HEATEREN);
  else
    writeCommand(SHT31_HEATERDIS);
}

/**************************************************************************
 **************************************************************************
 **************************************************************************
 * Sensor periodic mode code
 **************************************************************************
 **************************************************************************
 **************************************************************************/

 void Adafruit_SHT31::enablePeriodic(Adafruit_SHT31D_Repeatability rep, Adafruit_SHT31D_PeriodicFrequency freq) {
   _rep = rep;
   _freq = freq;
   _periodic = true;
   startPeriodic();
 }
 void Adafruit_SHT31::stopPeriodic() {
   writeCommand(SHT31_MEAS_BREAK);
   _periodic = false;
 }

 /**************************************************************************/
 /*!
     @brief Enables periodic measurements on the sensor using the values
            configured in _periodic, _rep and _freq
 */
 /**************************************************************************/

 void Adafruit_SHT31::startPeriodic() {
   // Find right command for this periodic measurement
   uint16_t cmd;
   switch (_rep) {
	    case REPEATABILITY_HIGH:
        switch (_freq) {
          case FREQUENCY_HALFHZ:
            cmd = SHT31_MEAS_HALFHZ_HIGHREP;
            break;
          case FREQUENCY_1HZ:
            cmd = SHT31_MEAS_1HZ_HIGHREP;
            break;
          case FREQUENCY_2HZ:
            cmd = SHT31_MEAS_2HZ_HIGHREP;
            break;
          case FREQUENCY_4HZ:
            cmd = SHT31_MEAS_4HZ_HIGHREP;
            break;
          case FREQUENCY_10HZ:
            cmd = SHT31_MEAS_10HZ_HIGHREP;
            break;
        }
        break;
      case REPEATABILITY_MEDIUM:
        switch (_freq) {
          case FREQUENCY_HALFHZ:
            cmd = SHT31_MEAS_HALFHZ_MEDREP;
            break;
          case FREQUENCY_1HZ:
            cmd = SHT31_MEAS_1HZ_MEDREP;
            break;
          case FREQUENCY_2HZ:
            cmd = SHT31_MEAS_2HZ_MEDREP;
            break;
          case FREQUENCY_4HZ:
            cmd = SHT31_MEAS_4HZ_MEDREP;
            break;
          case FREQUENCY_10HZ:
            cmd = SHT31_MEAS_10HZ_MEDREP;
            break;
        }
        break;
      case REPEATABILITY_LOW:
        switch (_freq) {
          case FREQUENCY_HALFHZ:
            cmd = SHT31_MEAS_HALFHZ_LOWREP;
            break;
          case FREQUENCY_1HZ:
            cmd = SHT31_MEAS_1HZ_LOWREP;
            break;
          case FREQUENCY_2HZ:
            cmd = SHT31_MEAS_2HZ_LOWREP;
            break;
          case FREQUENCY_4HZ:
            cmd = SHT31_MEAS_4HZ_LOWREP;
            break;
          case FREQUENCY_10HZ:
            cmd = SHT31_MEAS_10HZ_LOWREP;
            break;
        }
        break;
      default:
        // Invalid parameter combination? Return lowest possible...
        cmd = SHT31_MEAS_HALFHZ_LOWREP;
   }

   // Now that we know the command, start the periodic measurements
   writeCommand(cmd);
 }


 /**************************************************************************
  **************************************************************************
  **************************************************************************
  * Sensor measurement code
  **************************************************************************
  **************************************************************************
  **************************************************************************/

float Adafruit_SHT31::readTemperature(bool force) {
  if (! readTempHum(force)) return NAN;
  return temp;
}

float Adafruit_SHT31::readHumidity(bool force) {
  if (! readTempHum(force)) return NAN;
  return humidity;
}

// Force: skips cache and forces new measurement
boolean Adafruit_SHT31::readTempHum(bool force) {
  uint8_t readbuffer[6];

  // Did we read already the sensor in the last 100ms? No update then, so
  // provide previous result; in case of millis() overflow, also return last result
  // Note: in periodic mode this is necessary to avoid the sensor read failing
  // (have not investigated why)
  uint32_t now = millis();
  if (!force && (((now - _lastreadtime) < SHT31_MEASUREMENTCACHETTL) || (now < _lastreadtime))) {
    // Reuse last measurement, so report as succesful
    return true;
  }
  _lastreadtime = now;

  // Read command varies on whether we are in single shot or periodic mode
  if(_periodic) {
    writeCommand(SHT31_MEAS_FETCH);
  } else {
    // Adafruit default reads high repeatability
    writeCommand(SHT31_MEAS_HIGHREP);
  }

  // Wait for measurement to complete
  delay(SHT31_MEASUREMENTDELAY);

  // Read answer
  Wire.requestFrom(_i2caddr, (uint8_t)6);
  if (Wire.available() != 6)
    return false;
  for (uint8_t i=0; i<6; i++) {
    readbuffer[i] = Wire.read();
  //  Serial.print("0x"); Serial.println(readbuffer[i], HEX);
  }

  // Decode response
  uint16_t ST, SRH;
  ST = readbuffer[0];
  ST <<= 8;
  ST |= readbuffer[1];

  if (readbuffer[2] != crc8(readbuffer, 2)) return false;

  SRH = readbuffer[3];
  SRH <<= 8;
  SRH |= readbuffer[4];

  if (readbuffer[5] != crc8(readbuffer+3, 2)) return false;

  temp = rawToTemperature(ST);
  humidity = rawToHumidity(SRH);

  return true;
}

/**************************************************************************
 **************************************************************************
 **************************************************************************
 * Sensor value conversions
 **************************************************************************
 **************************************************************************
 **************************************************************************/

float Adafruit_SHT31::rawToTemperature(uint16_t rawvalue) {
  return (((175*(float)rawvalue) / 0xffff) - 45);
}

float Adafruit_SHT31::rawToHumidity(uint16_t rawvalue) {
  return ((100*(float)rawvalue) / 0xffff);
}

uint16_t Adafruit_SHT31::temperatureToRaw(double temperature) {
  return (((temperature + 45) * 0xFFFF) / 175);
}

uint16_t Adafruit_SHT31::humidityToRaw(double humidity) {
  return ((humidity * 0xFFFF) / 100);
}

/**************************************************************************
 **************************************************************************
 **************************************************************************
 * Alert limit configuration
 **************************************************************************
 **************************************************************************
 **************************************************************************/

// Provide actual temperature & humidity values; we'll do the conversion to raw sensor values
void Adafruit_SHT31::setAlertLimitsLow(Adafruit_SHT31D_AlertValues values) {
  uint16_t setvalues = encodeAlert(values.temperatureSet, values.humiditySet);
  uint16_t clearvalues = encodeAlert(values.temperatureClear, values.humidityClear);
  writeCommandData(SHT31_ALERT_WRITE_LOWSET, setvalues);
  writeCommandData(SHT31_ALERT_WRITE_LOWCLR, clearvalues);
}

void Adafruit_SHT31::setAlertLimitsHigh(Adafruit_SHT31D_AlertValues values) {
  uint16_t setvalues = encodeAlert(values.temperatureSet, values.humiditySet);
  uint16_t clearvalues = encodeAlert(values.temperatureClear, values.humidityClear);
  writeCommandData(SHT31_ALERT_WRITE_HIGHSET, setvalues);
  writeCommandData(SHT31_ALERT_WRITE_HIGHCLR, clearvalues);
}

uint16_t Adafruit_SHT31::encodeAlert(float temp, float hum) {
  uint16_t rawtemp, rawhum;

  // Sanity check
  if (!(hum < 0.0) || (hum > 100.0) || (temp < -40.0) || (temp > 125.0)) {
    // Convert to 16-bit sensor values
    rawtemp = temperatureToRaw(temp);
    rawhum = humidityToRaw(hum);

    // Encode to a single 16-bit value
    // -> Keep 7 most significant bits for humidity, store them as 7 upper bits
    // -> Keep 9 most significant bits for temp, store them in lower 9 bits
    return (rawhum & 0B1111111000000000) | ((rawtemp >> 7) & 0B0000000111111111);
  }
  return 0;
}

// Retrieve stores values
Adafruit_SHT31D_AlertValues Adafruit_SHT31::readAlertLimitsLow() {
  Adafruit_SHT31D_AlertValues result;
  // Read Alert LOW SET values and decode them
  uint16_t rawValue = readAlertData(SHT31_ALERT_READ_LOWSET);
  result.temperatureSet = rawToTemperature((rawValue & 0B0000000111111111)<<7);    // Lower 9 bits of alert are temperature's 9 MSB bits.
  result.humiditySet = rawToHumidity(rawValue & 0B1111111000000000);

  // Read Alert LOW CLEAR values and decode them
  rawValue = readAlertData(SHT31_ALERT_READ_LOWCLR);
  result.temperatureClear = rawToTemperature((rawValue & 0B0000000111111111)<<7);
  result.humidityClear = rawToHumidity(rawValue & 0B1111111000000000);
  return result;
}

Adafruit_SHT31D_AlertValues Adafruit_SHT31::readAlertLimitsHigh() {
  Adafruit_SHT31D_AlertValues result;
  // Default values
  result.temperatureSet = NAN; result.temperatureClear = NAN;
  result.humiditySet = NAN; result.humidityClear = NAN;

  // Read Alert HIGH SET values and decode them
  uint16_t rawValue = readAlertData(SHT31_ALERT_READ_HIGHSET);
  if (rawValue > 0) {
    result.temperatureSet = rawToTemperature((rawValue & 0B0000000111111111)<<7);    // Lower 9 bits of alert are temperature's 9 MSB bits.
    result.humiditySet = rawToHumidity(rawValue & 0B1111111000000000);
  }

  // Read Alert HIGH CLEAR values and decode them
  rawValue = readAlertData(SHT31_ALERT_READ_HIGHCLR);
  if (rawValue > 0) {
    result.temperatureClear = rawToTemperature((rawValue & 0B0000000111111111)<<7);
    result.humidityClear = rawToHumidity(rawValue & 0B1111111000000000);
  }
  return result;
}

uint16_t Adafruit_SHT31::readAlertData(uint16_t command) {
  uint8_t readbuffer[3];

  // Send command for retrieving alerts
  writeCommand(command);
  // Read answer
  Wire.requestFrom(_i2caddr, (uint8_t)3);
  if (Wire.available() != 3)
    return false;
  for (uint8_t i=0; i<3; i++) {
    readbuffer[i] = Wire.read();
  }

  // Decode response
  uint16_t rawValue;
  rawValue = readbuffer[0];
  rawValue <<= 8;
  rawValue |= readbuffer[1];

  if (readbuffer[2] != crc8(readbuffer, 2)) {
    //Serial.println(" **** SHT31 - CHECKSUM MISMATCH when reading alert data");
    return 0;
  }

  return rawValue;
}

/**************************************************************************
 **************************************************************************
 **************************************************************************
 * CRC code
 **************************************************************************
 **************************************************************************
 **************************************************************************/

uint8_t Adafruit_SHT31::crc8(const uint8_t *data, int len)
{
/*
*
 * CRC-8 formula from page 14 of SHT spec pdf
 *
 * Test data 0xBE, 0xEF should yield 0x92
 *
 * Initialization data 0xFF
 * Polynomial 0x31 (x8 + x5 +x4 +1)
 * Final XOR 0x00
 */

  const uint8_t POLYNOMIAL(0x31);
  uint8_t crc(0xFF);

  for ( int j = len; j; --j ) {
      crc ^= *data++;

      for ( int i = 8; i; --i ) {
	crc = ( crc & 0x80 )
	  ? (crc << 1) ^ POLYNOMIAL
	  : (crc << 1);
      }
  }
  return crc;
}


/**************************************************************************
 **************************************************************************
 **************************************************************************
 * I2C code
 **************************************************************************
 **************************************************************************
 **************************************************************************/

// Write a single command
void Adafruit_SHT31::writeCommand(uint16_t cmd) {
  Wire.beginTransmission(_i2caddr);
  Wire.write(cmd >> 8);
  Wire.write(cmd & 0xFF);
  Wire.endTransmission();
}

// Write a command, data, and include CRC
void Adafruit_SHT31::writeCommandData(uint16_t cmd, uint16_t data) {
  uint8_t array[2];
  array[0] = data >> 8;
  array[1] = data & 0xFF;
  uint8_t crc = crc8(array, 2);
  Wire.beginTransmission(_i2caddr);
  Wire.write(cmd >> 8);
  Wire.write(cmd & 0xFF);
  Wire.write(array[0]);
  Wire.write(array[1]);
  Wire.write(crc);
  Wire.endTransmission();
}

/*********************************************************************/
